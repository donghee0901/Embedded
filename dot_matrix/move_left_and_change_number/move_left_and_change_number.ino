#define ROW_0 4
#define COL_0 12

char value_0 = 0x23;
char value_1 = 0x37;

int value[8] = {0x00, 0x38, 0x44, 0x04, 0x08, 0x10, 0x20, 0x7C};

int numbers[10][8] = {
  {0x00, 0x38, 0x44, 0x4C, 0x54, 0x64, 0x44, 0x38},
  {0x00, 0x10, 0x30, 0x50, 0x10, 0x10, 0x10, 0x7c},
  {0x00, 0x38, 0x44, 0x04, 0x08, 0x10, 0x20, 0x7c},
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  {0x00, 0x38, 0x44, 0x44, 0x3C, 0x04, 0x44, 0x38}
};

int count = 0;
int dot_num = 0;
int move = 0;
int save_value = 0x00;

void setup()
{
  Serial.begin(9600);


  for (int i = 0; i < 16; i++) {
    pinMode(i + COL_0, OUTPUT);
  }
  for (int i = 0; i < 8; i++)
  {
    digitalWrite(ROW_0 + i, LOW);
  }

  Serial.begin(9600);
  TCCR1A = 0x00;
  TCCR1B = 0x0D;
  TCCR1C = 0x00;

  OCR1A = 625;

  TIMSK1 = 0x02;
}

void loop()
{
  for (int j = 0; j < 8; j++)
  {
    for (int i = 0; i < 8; i++)
    {
      digitalWrite(ROW_0 + i, LOW);
    }

    for (int i = 0; i < 8; i++) {
      save_value = numbers[dot_num][j];
      save_value = save_value << move;
      save_value |= (numbers[dot_num][j] >> (8 - move));
      if ((save_value & (0x80 >> i)) != 0)digitalWrite(i + COL_0, LOW);
      else digitalWrite(i + COL_0, HIGH);
    }

    digitalWrite(ROW_0 + j, HIGH);
    delay(1);
  }
  count++;
  if (count == 125)
  {
    count = 0;
    dot_num++;
    if (dot_num == 10)
    {
      dot_num = 0;
    }
  }
}
unsigned long ISR_count = 0;
ISR(TIMER1_COMPA_vect)
{
  ISR_count++;
  if (ISR_count == 5) {

    move++;

    if(move == 8)move = 0;

    ISR_count = 0;
  }
}
